## conf/layer.conf
```bitbake
# We have a conf directory, append to BBPATH
BBPATH .= ":${LAYERDIR}"

# We have a recipes directory, add to BBFILES
BBFILES += "${LAYERDIR}/recipes*/*.bb ${LAYERDIR}/recipes*/*.bbappend"

BBFILE_COLLECTIONS += "meta-kde"
BBFILE_PATTERN_meta-kde := "^${LAYERDIR}/"
BBFILE_PRIORITY_meta-kde = "10"
```
